/*
 * Copyright (c) 2016-2021, The Linux Foundation. All rights reserved.
 *
 * This program is free software; you can redistribute it and/or modify
 * it under the terms of the GNU General Public License version 2 and
 * only version 2 as published by the Free Software Foundation.
 *
 * This program is distributed in the hope that it will be useful,
 * but WITHOUT ANY WARRANTY; without even the implied warranty of
 * MERCHANTABILITY or FITNESS FOR A PARTICULAR PURPOSE.  See the
 * GNU General Public License for more details.
 */

/dts-v1/;
#include "ipq9574-db-al01-c1.dts"
/ {
	machid = <0x1050200>;
	config_name = "config@db-al01-c3", "config-db-al01-c3";

	ess-switch {
		/* Overriding port6 configuration to support AQ instead
		 * of QCA808x
		 */
		/delete-property/qca808x_gpio;
		/delete-property/qca808x_gpio_cnt;
		switch_mac_mode2 = <PORT_WRAPPER_USXGMII>;
		aquantia_port = <4 5>;
		aquantia_port_cnt = <2>;
		port_phyinfo {
			port@5 {
				phy_address = <0>;
				phy_type = <AQ_PHY_TYPE>;
			};
		};
	};
};
