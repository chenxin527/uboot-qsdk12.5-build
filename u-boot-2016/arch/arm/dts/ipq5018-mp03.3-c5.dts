/*
 * Copyright (c) 2016-2021, The Linux Foundation. All rights reserved.
 *
 * This program is free software; you can redistribute it and/or modify
 * it under the terms of the GNU General Public License version 2 and
 * only version 2 as published by the Free Software Foundation.
 *
 * This program is distributed in the hope that it will be useful,
 * but WITHOUT ANY WARRANTY; without even the implied warranty of
 * MERCHANTABILITY or FITNESS FOR A PARTICULAR PURPOSE.  See the
 * GNU General Public License for more details.
 */
#include "ipq5018-mp03.3.dts"
/ {
	model ="QCA, IPQ5018-MP03.3-C5";
	compatible = "qca,ipq5018", "qca,ipq5018-mp03.3-c5";
	machid = <0x8040402>;
	config_name = "config@mp03.3-c5", "config-mp03.3-c5";
};
