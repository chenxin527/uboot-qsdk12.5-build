## u-boot-2016/arch/arm/cpu/armv7/qca/common/Kconfig
```kconfig
config QCA_COMMON
	bool "QCA Common IPs"

config SKIP_RESET
	bool "Skip reset after crash dump"
	default n
```

## u-boot-2016/board/ipq40xx/Kconfig
```kconfig
if ARCH_IPQ40xx

config SYS_CPU
	default "ipq40xx"

config SYS_BOARD
	default "ipq40xx"

config SYS_VENDOR
	default "qca/arm"

config SYS_CONFIG_NAME
	default "ipq40xx"

config IPQ40XX_I2C
	bool "ipq40xx i2c"

config USB_XHCI_IPQ
	bool "ipq40xx usb"

config PCI_IPQ
	bool "ipq40xx pci"

config BOARD_TYPES
	bool "Support board_type member in global data"
	default y
endif
```

## u-boot-2016/board/ipq5018/Kconfig
```kconfig
if ARCH_IPQ5018

config SYS_CPU
       default "ipq5018"

config SYS_BOARD
       default "ipq5018"

config SYS_VENDOR
       default "qca/arm"

config SYS_CONFIG_NAME
       default "ipq5018"

config IPQ_I2C
	bool "Enable i2c support on IPQ platform"

config USB_XHCI_IPQ
	bool "Enable usb support for ipq5018"

config PCI_IPQ
	bool "Enable pci support for ipq5018"

config MMC_FLASH
	bool "Enable MMC flash support for ipq5018"

config IPQ_TZT
	bool "Enable TZ test command for ipq5018"

config UBI_WRITE
	bool "Enable ubi volume write command for ipq5018"

config QPIC_SERIAL
	bool "Enable QPIC serial spi nand  for ipq5018"

config IPQ_TINY
	bool "Enable Tiny support for ipq5018"

config IPQ_MTD_NOR
	bool "Register nor in MTD framework for ipq5018"

config IPQ_TINY_SPI_NOR
	bool "This config helps to update spi-nor related updated in ipq5018"

config NAND_FLASH
	bool "Enable NAND driver for ipq5018"

config GEPHY
	bool "Enable Internel GEPHY for ipq5018"

config ART_COMPRESSED
	bool "Enable uncompress support for ipq5018"

config BOARD_TYPES
	bool "Support board_type member in global data"
	default y

config LIST_OF_CONFIG_NAMES_SUPPORT
	bool "List of config names support"

config LIST_FUSE
	bool "Enable fuse list command"
	default n
endif
```

## u-boot-2016/board/ipq5332/Kconfig
```kconfig
if ARCH_IPQ5332

config SYS_CPU
       default "ipq5332"

config SYS_BOARD
       default "ipq5332"

config SYS_VENDOR
       default "qca/arm"

config SYS_CONFIG_NAME
       default "ipq5332"

config NAND_FLASH
	bool "Enable NAND Framework"

config REDUCE_FOOTPRINT
	bool "Remove/reconfigure code to reduce footprint"

config QPIC_SERIAL
	bool "Enable QPIC serial NAND"

config UBI_WRITE
	bool "Enable ubi utilities"

config MMC_FLASH
	bool "Enable MMC flash support"

config IPQ_TZT
	bool "Enable TZ test command"

config PCI_IPQ
	bool "Enable pci support"

config USB_XHCI_IPQ
	bool "Enable usb support"

config IPQ_I2C
	bool "Enable i2c support"

config IPQ_TINY
	bool "Enable Tiny support"

config IPQ_TINY_SPI_NOR
	bool "This config helps to update spi-nor"

config ART_COMPRESSED
	bool "Enable uncompress support"

config QCA8033_PHY
	bool "Enable QCA8033 PHY support"

config QCA8081_PHY
	bool "Enable QCA8081 PHY support"

config DPR_EXECUTE
	bool "Enable DPR support"

config BOARD_TYPES
	bool "Support board_type member in global data"
	default y

config LIST_OF_CONFIG_NAMES_SUPPORT
	bool "List of config names support"

config IPQ_TINY2
	select IPQ_TINY
	bool "Enable tiny2 profile"

config LIST_FUSE
	bool "Enable fuse list command"
	default y
endif
```

## u-boot-2016/board/ipq6018/Kconfig
```kconfig
if ARCH_IPQ6018

config SYS_CPU
       default "ipq6018"

config SYS_BOARD
       default "ipq6018"

config SYS_VENDOR
       default "qca/arm"

config SYS_CONFIG_NAME
       default "ipq6018"

config USB_XHCI_IPQ
	bool "Enable usb support for ipq6018"

config PCI_IPQ
	bool "Enable pci support for ipq6018"

config IPQ6018_QCA_AQUANTIA_PHY
	bool "Enable Aquantia PHY support for ipq6018"

config BOARD_TYPES
	bool "Support board_type member in global data"
	default y

config LIST_OF_CONFIG_NAMES_SUPPORT
	bool "List of config names support"

config LIST_FUSE
	bool "Enable fuse list command"
	default n
endif
```

## u-boot-2016/board/ipq806x/Kconfig
```kconfig
if ARCH_IPQ806x

config SYS_CPU
	default "ipq806x"

config SYS_BOARD
	default "ipq806x"

config SYS_VENDOR
	default "qca/arm"

config SYS_CONFIG_NAME
	default "ipq806x"
config IPQ806X_I2C
	bool "ipq806x i2c"

config USB_XHCI_IPQ
	bool "ipq806x usb"

config PCI_IPQ
	bool "ipq806x pci"

config BOARD_TYPES
	bool "Support board_type member in global data"
	default y

endif
```

## u-boot-2016/board/ipq807x/Kconfig
```kconfig
config SYS_CPU
       default "ipq807x"

config SYS_BOARD
       default "ipq807x"

config SYS_VENDOR
       default "qca/arm"

config SYS_CONFIG_NAME
       default "ipq807x"

config IPQ_I2C
	bool "Enable i2c support on IPQ platform"

config USB_XHCI_IPQ
	bool "ipq807x usb support for ipq807x"

config PCI_IPQ
	bool "ipq807x pci support for ipq807x"

config QCA_AQUANTIA_PHY
	bool "Enable Aquantia PHY support for ipq807x"

config QCA8033_PHY
	bool "Enable QCA8033 PHY support for ipq807x"

config QCA8081_PHY
	bool "Enable QCA8081 PHY support for ipq807x"

config QCA8075_PHY
	bool "Enable QCA8075 PHY support for ipq807x"

config BOARD_TYPES
	bool "Support board_type member in global data"
	default y

config LIST_OF_CONFIG_NAMES_SUPPORT
	bool "List of config names support"

config LIST_FUSE
	bool "Enable fuse list command"
	default n
```

## u-boot-2016/board/ipq9574/Kconfig
```kconfig
if ARCH_IPQ9574

config SYS_CPU
       default "ipq9574"

config SYS_BOARD
       default "ipq9574"

config SYS_VENDOR
       default "qca/arm"

config SYS_CONFIG_NAME
       default "ipq9574"

config IPQ9574_QCA_AQUANTIA_PHY
	bool "Enable Aquantia PHY support for ipq9574"

config IPQ9574_QCA8075_PHY
	bool "Enable Malibu PHY support for ipq9574"

config BOARD_TYPES
	bool "Support board_type member in global data"
	default y

config LIST_OF_CONFIG_NAMES_SUPPORT
	bool "List of config names support"

config LIST_FUSE
	bool "Enable fuse list command"
	default y
endif
```

## u-boot-2016/board/qca/mips32/qca953x/Kconfig
```kconfig
if TARGET_QCA953X

config SYS_CPU
	default "qca953x"

config SYS_BOARD
	default "mips32/qca953x"

config SYS_VENDOR
	default "qca"

config SYS_CONFIG_NAME
	default "qca953x"

endif
```

## u-boot-2016/board/qca/mips32/qca955x/Kconfig
```kconfig
if TARGET_QCA955X

config SYS_CPU
	default "qca955x"

config SYS_BOARD
	default "mips32/qca955x"

config SYS_VENDOR
	default "qca"

config SYS_CONFIG_NAME
	default "qca955x"

endif
```

## u-boot-2016/board/qca/mips32/qca956x/Kconfig
```kconfig
if TARGET_QCA956X

config SYS_CPU
	default "qca956x"

config SYS_BOARD
	default "mips32/qca956x"

config SYS_VENDOR
	default "qca"

config SYS_CONFIG_NAME
	default "qca956x"

endif
```

## u-boot-2016/configs/ipq5332_tiny_nor_defconfig
```kconfig
CONFIG_ARM=y
CONFIG_HAS_VBAR=y
CONFIG_CPU_V7=y
CONFIG_ARCH_IPQ5332=y
CONFIG_SYS_MALLOC_F_LEN=0x400
CONFIG_SYS_MALLOC_F=y
CONFIG_DM_SERIAL=y
CONFIG_DEFAULT_DEVICE_TREE=""
CONFIG_LOCALVERSION=""
CONFIG_LOCALVERSION_AUTO=y
CONFIG_CC_OPTIMIZE_FOR_SIZE=y
CONFIG_EXPERT=y
CONFIG_SYS_MALLOC_CLEAR_ON_INIT=y
CONFIG_FIT=y
CONFIG_FIT_VERBOSE=y
# CONFIG_FIT_SIGNATURE is not set
CONFIG_SYS_EXTRA_OPTIONS=""
CONFIG_SYS_PROMPT="IPQ5332# "

#
# Tiny support
#
CONFIG_IPQ_TINY=y
CONFIG_REDUCE_FOOTPRINT=y

#
# Info commands
#
# CONFIG_CMD_BDI is not set
# CONFIG_CMD_CONSOLE is not set

#
# Boot commands
#
# CONFIG_CMD_BOOTD is not set
CONFIG_CMD_BOOTM=y
# CONFIG_CMD_GO is not set
CONFIG_CMD_RUN=y
# CONFIG_CMD_IMI is not set
# CONFIG_CMD_IMLS is not set
# CONFIG_CMD_XIMG is not set

#
# Environment commands
#
CONFIG_CMD_EXPORTENV=y
CONFIG_CMD_IMPORTENV=y
CONFIG_CMD_EDITENV=y
CONFIG_CMD_SAVEENV=y
CONFIG_CMD_ENV_EXISTS=y

#
# Memory commands
#
CONFIG_CMD_MEMORY=y
CONFIG_CMD_CRC32=y
# CONFIG_LOOPW is not set
# CONFIG_CMD_MEMTEST is not set
# CONFIG_CMD_MX_CYCLIC is not set
# CONFIG_CMD_MEMINFO is not set

#
# Device access commands
#

# CONFIG_CMD_DM is not set
# CONFIG_CMD_DEMO is not set
# CONFIG_CMD_LOADB is not set
# CONFIG_CMD_LOADS is not set
# CONFIG_CMD_FLASH is not set
# CONFIG_CMD_NAND is not set
# CONFIG_CMD_SF is not set
# CONFIG_CMD_SPI is not set
# CONFIG_CMD_I2C is not set
# CONFIG_CMD_USB is not set
# CONFIG_CMD_FPGA is not set

#
# Shell scripting commands
#
CONFIG_CMD_ECHO=y
# CONFIG_CMD_ITEST is not set
CONFIG_CMD_SOURCE=y
# CONFIG_CMD_SETEXPR is not set

#
# Network commands
#

#
# Network PHY
#
# CONFIG_IPQ_QCA_AQUANTIA_PHY is not set
# CONFIG_QCA8033_PHY is not set
CONFIG_QCA8081_PHY=y
CONFIG_QCA8084_PHY=y
CONFIG_QCA8084_SWT_MODE=y
# CONFIG_QCA8084_BYPASS_MODE is not set
# CONFIG_ATHRS17C_SWITCH is not set

CONFIG_CMD_NET=y
# CONFIG_CMD_TFTPPUT is not set
# CONFIG_CMD_TFTPSRV is not set
# CONFIG_CMD_RARP is not set
# CONFIG_CMD_DHCP is not set
# CONFIG_CMD_NFS is not set
# CONFIG_CMD_PING is not set
# CONFIG_CMD_CDP is not set
# CONFIG_CMD_SNTP is not set
# CONFIG_CMD_DNS is not set
# CONFIG_CMD_LINK_LOCAL is not set

#
# Misc commands
#
# CONFIG_CMD_TIME is not set
CONFIG_CMD_MISC=y
# CONFIG_CMD_PART is not set
# CONFIG_PARTITION_UUIDS is not set
# CONFIG_CMD_TIMER is not set
# CONFIG_IPQ_TZT is not set
# CONFIG_UBI_WRITE is not set
#
# Boot timing
#
# CONFIG_BOOTSTAGE is not set
CONFIG_BOOTSTAGE_USER_COUNT=20
CONFIG_BOOTSTAGE_STASH_ADDR=0
CONFIG_BOOTSTAGE_STASH_SIZE=4096

#
# Power commands
#

#
# Security commands
#
CONFIG_SUPPORT_OF_CONTROL=y

#
# Device Tree Control
#
CONFIG_OF_CONTROL=y
CONFIG_OF_BOARD_FIXUP=y
CONFIG_OF_SEPARATE=y
# CONFIG_OF_EMBED is not set
CONFIG_NET=y
# CONFIG_NET_RANDOM_ETHADDR is not set
# CONFIG_NETCONSOLE is not set

#
# Device Drivers
#

#
# Generic Driver Options
#
CONFIG_DM=y
CONFIG_DM_WARN=y
CONFIG_DM_DEVICE_REMOVE=y
CONFIG_DM_STDIO=y
CONFIG_DM_SEQ_ALIAS=y
# CONFIG_REGMAP is not set
# CONFIG_DEVRES is not set
CONFIG_SIMPLE_BUS=y
# CONFIG_CLK is not set
# CONFIG_CPU is not set

#
# Hardware crypto devices
#
# CONFIG_FSL_CAAM is not set

#
# Demo for driver model
#
# CONFIG_DM_DEMO is not set

#
# DFU support
#
# CONFIG_DFU_TFTP is not set

#
# GPIO Support
#
# CONFIG_LPC32XX_GPIO is not set
# CONFIG_VYBRID_GPIO is not set

#
# I2C support
#
# CONFIG_DM_I2C_COMPAT is not set
# CONFIG_CROS_EC_KEYB is not set
# CONFIG_IPQ_I2C is not set

#
# LED Support
#
# CONFIG_LED is not set

#
# Multifunction device drivers
#
# CONFIG_CROS_EC is not set
# CONFIG_FSL_SEC_MON is not set
# CONFIG_PCA9551_LED is not set
# CONFIG_RESET is not set

#
# MMC Host controller Support
#
# CONFIG_DM_MMC is not set
# CONFIG_MMC_FLASH is not set

#
# NAND Device Support
#
# CONFIG_NAND_DENALI is not set
# CONFIG_NAND_VF610_NFC is not set
# CONFIG_NAND_PXA3XX is not set

#
# Generic NAND options
#
# CONFIG_NAND_FLASH is not set

#
# Serial NAND
#
# CONFIG_QPIC_SERIAL is not set

#
# SPI Flash Support

#
# CONFIG_SPI_FLASH is not set
# CONFIG_DM_ETH is not set
# CONFIG_PHYLIB is not set
# CONFIG_NETDEVICES is not set
# CONFIG_IPQ_MTD_NOR is not set
CONFIG_IPQ_TINY_SPI_NOR=y

#
# PCI
#
# CONFIG_DM_PCI is not set
# CONFIG_PCI_IPQ is not set

#
# Pin controllers
#
# CONFIG_PINCTRL is not set

#
# Power
#
# CONFIG_DM_PMIC is not set
# CONFIG_DM_REGULATOR is not set
# CONFIG_RAM is not set

#
# Real Time Clock
#
# CONFIG_DM_RTC is not set

#
# Serial drivers
#
CONFIG_REQUIRE_SERIAL_CONSOLE=y
# CONFIG_DEBUG_UART is not set

#

# Sound support
#
# CONFIG_SOUND is not set

#
# SPI Support
#
# CONFIG_FSL_ESPI is not set
# CONFIG_TI_QSPI is not set
# CONFIG_DM_THERMAL is not set

#
# TPM support
#

#
# USB support
#
# CONFIG_USB is not set
# CONFIG_DM_USB is not set
# CONFIG_USB_XHCI_IPQ is not set

#
# Graphics support
#
# CONFIG_VIDEO_VESA is not set
# CONFIG_VIDEO_LCD_ANX9804 is not set
# CONFIG_VIDEO_LCD_SSD2828 is not set
# CONFIG_DISPLAY_PORT is not set
# CONFIG_VIDEO_TEGRA124 is not set
# CONFIG_VIDEO_BRIDGE is not set
# CONFIG_PHYS_TO_BUS is not set

#
# File systems
#

#
# Library routines

#
# CONFIG_CC_OPTIMIZE_LIBS_FOR_SPEED is not set
CONFIG_HAVE_PRIVATE_LIBGCC=y
CONFIG_USE_PRIVATE_LIBGCC=y
CONFIG_SYS_HZ=1000
# CONFIG_SYS_VSNPRINTF is not set
CONFIG_REGEX=y
# CONFIG_LIB_RAND is not set
# CONFIG_CMD_DHRYSTONE is not set
# CONFIG_RSA is not set
# CONFIG_TPM is not set

#
# Hashing Support
#
# CONFIG_SHA1 is not set
# CONFIG_SHA256 is not set
# CONFIG_SHA_HW_ACCEL is not set

#
# Compression Support
#
# CONFIG_LZ4 is not set
CONFIG_LZMA=y
# CONFIG_ERRNO_STR is not set
# CONFIG_UNIT_TEST is not set

CONFIG_SYS_THUMB_BUILD=y
CONFIG_HAS_THUMB2=y

#
# ART uncompression support
#
CONFIG_ART_COMPRESSED=y

#
# DPR support
#
CONFIG_DPR_EXECUTE=y
```

## u-boot-2016/configs/qca956x_defconfig
```kconfig
CONFIG_MIPS=y
CONFIG_TARGET_QCA956X=y
CONFIG_SYS_EXTRA_OPTIONS="QCA956X"
CONFIG_SYS_PROMPT="QCA956X# "
# CONFIG_CMD_BDI is not set
# CONFIG_CMD_ELF is not set
CONFIG_CMD_RUN=y
CONFIG_CMD_SAVEENV=y
CONFIG_CMD_PING=y
# CONFIG_CMD_LOADB is not set
# CONFIG_CMD_LOADS is not set
CONFIG_CMD_FLASH=y
# CONFIG_CMD_FPGA is not set
# CONFIG_CMD_SETEXPR is not set
CONFIG_USE_PRIVATE_LIBGCC=y
CONFIG_SYS_MALLOC_F_LEN=0x200
CONFIG_SYS_MALLOC_F=y
```
